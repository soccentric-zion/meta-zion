## conf/layer.conf
```bitbake
BBPATH .= ":${LAYERDIR}"

BBFILES += " \
    ${LAYERDIR}/recipes-*/*/*.bb \
    ${LAYERDIR}/recipes-*/*/*.bbappend \
"

BBFILE_COLLECTIONS += "meta-zion"
BBFILE_PATTERN_meta-zion = "^${LAYERDIR}/"
BBFILE_PRIORITY_meta-zion = "10"

LAYERDEPENDS_meta-zion = "core xilinx kria"
LAYERSERIES_COMPAT_meta-zion = "scarthgap"
```
